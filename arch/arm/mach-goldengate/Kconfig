## arch/arm/mach-goldengate/Kconfig
```kconfig
menuconfig ARCH_GOLDENGATE
	bool "Cortina Systems Golden-Gate family"
	depends on ARCH_MULTI_V7
	select ARM_AMBA
	select ARM_GIC
	select HAVE_SMP
	select HAVE_ARM_SCU
	select HAVE_ARM_TWD if SMP
	select PINCTRL
	select PCI
	select GOLDENGATE_CLK
	select GOLDENGATE_IRQ
	help
	  Support for Cortina CS7542/7522 SoCs
	  ARM core: Cortex-A9-r2p7
	  L2 Cache : PL310-r3p1

if ARCH_GOLDENGATE

endif	# ARCH_GOLDENGATE
```
